## Config.in
```kconfig
menu "QHB Gateway"
	source "$BR2_EXTERNAL_QHB_GATEWAY_PATH/package/qhb-zigbeed/Config.in"
	source "$BR2_EXTERNAL_QHB_GATEWAY_PATH/package/qhb-btproxy/Config.in"
	source "$BR2_EXTERNAL_QHB_GATEWAY_PATH/package/qhb-dectd/Config.in"
	source "$BR2_EXTERNAL_QHB_GATEWAY_PATH/package/qhb-rfe-daemon/Config.in"
endmenu
```

## configs/qhb_defconfig
```kconfig
# QHB defconfig - Telekom Qivicon Home Base 2 (HiSilicon SD5650T, Cortex-A9, soft-float)
BR2_arm=y
BR2_cortex_a9=y
BR2_ARM_EABI=y
BR2_TOOLCHAIN_BUILDROOT_UCLIBC=y
BR2_KERNEL_HEADERS_VERSION=y
BR2_DEFAULT_KERNEL_VERSION="3.4.113"
BR2_PACKAGE_HOST_LINUX_HEADERS_CUSTOM_3_4=y
BR2_TOOLCHAIN_BUILDROOT_CXX=y

# System & init
BR2_TARGET_GENERIC_HOSTNAME="qhb"
BR2_TARGET_GENERIC_ISSUE="Qivicon Home Base 2 (qhb-gateway)"
BR2_TARGET_GENERIC_GETTY_PORT="ttyAMA1"
BR2_TARGET_GENERIC_GETTY_BAUDRATE_115200=y
BR2_INIT_BUSYBOX=y
BR2_PACKAGE_BUSYBOX=y
BR2_PACKAGE_BUSYBOX_CONFIG_FRAGMENT_FILES="$(BR2_EXTERNAL_QHB_GATEWAY_PATH)/board/qhb/busybox.fragment"

# Board overlay & build hooks
BR2_ROOTFS_OVERLAY="$(BR2_EXTERNAL_QHB_GATEWAY_PATH)/board/qhb/rootfs_overlay"
BR2_ROOTFS_POST_BUILD_SCRIPT="$(BR2_EXTERNAL_QHB_GATEWAY_PATH)/board/qhb/post-build.sh"
BR2_ROOTFS_POST_IMAGE_SCRIPT="$(BR2_EXTERNAL_QHB_GATEWAY_PATH)/board/qhb/post-image.sh"

# Core utilities & networking
BR2_PACKAGE_DROPBEAR=y
BR2_PACKAGE_SER2NET=y
BR2_PACKAGE_SOCAT=y
BR2_PACKAGE_ETHTOOL=y
BR2_PACKAGE_MTD=y

# QHB Gateway radio bridge daemons
BR2_PACKAGE_QHB_ZIGBEED=y
BR2_PACKAGE_QHB_BTPROXY=y
BR2_PACKAGE_QHB_DECTD=y
BR2_PACKAGE_QHB_RFE_DAEMON=y

# Output: compressed initramfs cpio for embedding in uImage (+ tar for inspection)
BR2_TARGET_ROOTFS_CPIO=y
BR2_TARGET_ROOTFS_CPIO_XZ=y
BR2_TARGET_ROOTFS_TAR=y
BR2_TARGET_ROOTFS_TAR_GZIP=y
```

## package/qhb-btproxy/Config.in
```kconfig
config BR2_PACKAGE_QHB_BTPROXY
	bool "qhb-btproxy"
	depends on BR2_TOOLCHAIN_HAS_THREADS
	help
	  ESPHome-compatible Bluetooth Proxy daemon for Home Assistant
	  on the Telekom Qivicon Home Base 2 (RTL8761AUV).
```

## package/qhb-dectd/Config.in
```kconfig
config BR2_PACKAGE_QHB_DECTD
	bool "qhb-dectd"
	help
	  DECT ULE / HAN-FUN MQTT bridge and Home Assistant Discovery
	  daemon for the Telekom Qivicon Home Base 2.
```

## package/qhb-rfe-daemon/Config.in
```kconfig
config BR2_PACKAGE_QHB_RFE_DAEMON
	bool "qhb-rfe-daemon"
	help
	  HB-RF-ETH compatible TCP bridge for the HomeMatic / HmIP
	  radio module on the Telekom Qivicon Home Base 2.
```

## package/qhb-zigbeed/Config.in
```kconfig
config BR2_PACKAGE_QHB_ZIGBEED
	bool "qhb-zigbeed"
	help
	  ASHv2 over TCP to EZSP-SPI bridge for the Silicon Labs EM3587
	  Zigbee NCP on the Telekom Qivicon Home Base 2.
```
